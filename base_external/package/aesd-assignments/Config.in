## base_external/package/aesd-assignments/Config.in
```kconfig
config BR2_PACKAGE_AESD_ASSIGNMENTS
    bool "aesd-assignments"
    help
      Add the AESD assignments package containing finder, writer, and tests
```
